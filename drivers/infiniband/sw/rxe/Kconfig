## drivers/infiniband/sw/rxe/Kconfig
```kconfig
# SPDX-License-Identifier: GPL-2.0-only
config RDMA_RXE
	tristate "Software RDMA over Ethernet (RoCE) driver"
	depends on INET && PCI && INFINIBAND && 64BIT
	depends on INFINIBAND_VIRT_DMA
	select NET_UDP_TUNNEL
	select CRC32
	help
	This driver implements the InfiniBand RDMA transport over
	the Linux network stack. It enables a system with a
	standard Ethernet adapter to interoperate with a RoCE
	adapter or with another system running the RXE driver.
	Documentation on InfiniBand and RoCE can be downloaded at
	www.infinibandta.org and www.openfabrics.org. (See also
	siw which is a similar software driver for iWARP.)

	The driver is split into two layers, one interfaces with the
	Linux RDMA stack and implements a kernel or user space
	verbs API. The user space verbs API requires a support
	library named librxe which is loaded by the generic user
	space verbs API, libibverbs. The other layer interfaces
	with the Linux network stack at layer 3.

	To configure and work with soft-RoCE driver please use the
	following wiki page under "configure Soft-RoCE (RXE)" section:

	https://github.com/linux-rdma/rdma-core/blob/master/Documentation/rxe.md

config RDMA_RXE_L2
	bool "Soft RoCE over Ethernet Layer"
	depends on RDMA_RXE
	help
	Software RoCE is still a routeable RoCE. In driver, the src/dst mac
	addresses are added to skb. So it is unnecessary to make route table
	lookup. And this skb can be directly sent to Ethernet adapter. This
	brings 2 benefits:
	1. avoid making route table lookup;
	2. avoid other operations in IP layer;
	This can enhance the throughput and lower the latency.
```
